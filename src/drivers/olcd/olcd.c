/********************************************
使用说明：
OLED电源使用3.3V。   
----------------
G    电源地
3.3V 接3.3V电源
D0   PORTA_PA14  
D1   PORTA_PA15
RST  PORTA_PA16 
DC   PORTA_PA17
CS   已接地，不用接
============================================
OLED电源使用5V。   
----------------
G    电源地
3.3V 接5V电源，电源跟模块之间串接100欧姆电阻，并加3.3V钳位二极管
D0   PORTA_PA14 单片机跟模块之间串接1k-3.3k电阻 
D1   PORTA_PA15 单片机跟模块之间串接1k-3.3k电阻 
RST  PORTA_PA16 单片机跟模块之间串接1k-3.3k电阻 
DC   PORTA_PA17 单片机跟模块之间串接1k-3.3k电阻 
CS   已接地，不用接  


4线SPI使用说明：
VBT 供内部DC-DC电压，3.3~4.3V，如果使用5V电压，为保险起见串一个100~500欧的电阻
VCC 供内部逻辑电压 1.8~6V   
GND 地

BS0 低电平
BS1 低电平
BS2 低电平

CS  片选管脚
DC  命令数据选择管脚
RES 模块复位管脚 
D0（SCLK） ，时钟脚，由MCU控制
D1（MOSI） ，主输出从输入数据脚，由MCU控制

D2 悬空      
D3-D7 ， 低电平 ， 也可悬空，但最好设为低电平
RD  低电平 ，也可悬空，但最好设为低电平
RW  低电平 ，也可悬空，但最好设为低电平
RD  低电平 ，也可悬空，但最好设为低电平   
============================================     
如果用户使用的是5V单片机，请看用户手册，切勿烧毁模块！  
============================================*/





#include "olcd.h"

#define XLevelL		0x00
#define XLevelH		0x10
#define XLevel		((XLevelH&0x0F)*16+XLevelL)
#define Max_Column	128
#define Max_Row		  64
#define	Brightness	0xCF 

#define X_WIDTH 128
#define Y_WIDTH 64
//======================================
const byte F6x8[][6] =
{
    { 0x00, 0x00, 0x00, 0x00, 0x00, 0x00 },   // sp
    { 0x00, 0x00, 0x00, 0x2f, 0x00, 0x00 },   // !
    { 0x00, 0x00, 0x07, 0x00, 0x07, 0x00 },   // "
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    { 0x14, 0x14, 0x14, 0x14, 0x14, 0x14 }    // horiz lines
};
//======================================================
// 128X64I液晶底层驱动[14X16]字体库
// 设计者: yangxj
// 描  述: 字符库：北京邮电大学智能车团队
//======================================================
const byte F16x16_Idx[] = 
{
	"北京邮电大学智能车设置发显示完成值测距速取消状态参数舵机调"
};
const byte F16x16[] = {  
	  0x00,0x20,0x20,0x20,0x20,0xFF,0x00,0x00,
      0xFF,0x20,0x10,0x08,0x0C,0x00,0x00,0x00,
      0x20,0x60,0x20,0x10,0x10,0x7F,0x00,0x00,
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      0x12,0x12,0x12,0x5E,0x80,0x7F,0x00,0x00,//"调", 
};

//======================================================
// 128X64I液晶底层驱动[8X16]字体库
// 设计者: powerint
// 描  述: [8X16]西文字符的字模数据 (纵向取模,字节倒序)
// !"#$%&'()*+,-./0123456789:;<=>?@ABCDEFGHIJKLMNOPQRSTUVWXYZ[\]^_`abcdefghijklmnopqrstuvwxyz{|}~
//======================================================
const byte F8X16[]=
{
  0x00,0x00,0x00,0x00,0x00,0x00,0x00,0x00,0x00,0x00,0x00,0x00,0x00,0x00,0x00,0x00,// 0
  0x00,0x00,0x00,0xF8,0x00,0x00,0x00,0x00,0x00,0x00,0x00,0x33,0x30,0x00,0x00,0x00,//!1
  0x00,0x10,0x0C,0x06,0x10,0x0C,0x06,0x00,0x00,0x00,0x00,0x00,0x00,0x00,0x00,0x00,//"2
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  0x00,0x06,0x01,0x01,0x02,0x02,0x04,0x04,0x00,0x00,0x00,0x00,0x00,0x00,0x00,0x00,//~94

};
//数据水平，字节垂直
//======================================================
// 北京邮电大学LOGO
// 设计者: yangxj
// 描  述: 北京邮电大学logo
//======================================================
byte BUPT72x48[432] = 
{

0x00,0x00,0x00,0x00,0x00,0x00,0x00,0x00,0x00,0x80,0x80,0xC0,0xE0,0xE0,0x70,0x70,
0x38,0xB8,0x98,0xDC,0xDC,0xCC,0xEE,0xEE,0xEE,0xE6,0xF6,0xF7,0xF7,0xF7,0xF3,0xF3,
0xF3,0xF3,0xF3,0xF3,0xF3,0xF3,0xF3,0xF3,0xF7,0xF7,0xF7,0xF7,0xF6,0xE6,0xEE,0xEE,
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0x00,0x00,0x00,0x00,0x00,0x00,0x00,0x00
 
}; 

void LCD_Set_Pos(byte x, byte y)
{ 
  LCD_WrCmd(0xb0+y);
  LCD_WrCmd(((x&0xf0)>>4)|0x10);
  LCD_WrCmd((x&0x0f)|0x01); 
} 
void LCD_Fill(byte bmp_data)
{
	byte y,x;
	
	for(y=0;y<8;y++)
	{
		LCD_WrCmd(0xb0+y);
		LCD_WrCmd(0x01);
		LCD_WrCmd(0x10);
		for(x=0;x<X_WIDTH;x++)
			LCD_WrDat(bmp_data);
	}
}
void LCD_CLS(void)
{
	byte y,x;	
	for(y=0;y<8;y++)
	{
		LCD_WrCmd(0xb0+y);
		LCD_WrCmd(0x01);
		LCD_WrCmd(0x10); 
		for(x=0;x<X_WIDTH;x++)
			LCD_WrDat(0);
	}
}
void LCD_DLY_ms(word ms)
{                         
  word a;
  while(ms)
  {
    a=96000/4;
    while(a--);
    ms--;
  }
  return;
}

void LCD_DLY_us(word us)
{                         
  word a;
  while(us)
  {
    a=180/4;
    while(a--);
    us--;
  }
  return;
}

void LCD_Init(void)        
{ 
  //初始化IO口，输出
  
#ifdef __IOSPI__
  PORTx ports[5] = {PORTA,PORTB,PORTC,PORTD,PORTE};
  gpio_init(ports[PORT_D0/32], PORT_D0%32,GPO,1);     //初始化gpio
  gpio_init(ports[PORT_D1/32], PORT_D1%32,GPO,0);     //初始化gpio
  gpio_init(ports[PORT_RES/32],PORT_RES%32,GPO,0);    //初始化gpio
  gpio_init(ports[PORT_DC/32], PORT_DC%32,GPO,0);     //初始化gpio
  
  SPI_RES = 0;
  LCD_DLY_ms(50);
  SPI_RES = 1;
#else
  gpio_init(ports[PORT_RES/32],PORT_RES%32,GPO,0);    //初始化gpio
  gpio_init(ports[PORT_DC/32], PORT_DC%32,GPO,0);     //初始化gpio
  
  SPI_init(SPI0);
  SPI_RES = 0;
  LCD_DLY_ms(50);
  SPI_RES = 1;
#endif
  
  LCD_WrCmd(0xae);//--turn off oled panel
  LCD_WrCmd(0x00);//---set low column address
  LCD_WrCmd(0x10);//---set high column address
  LCD_WrCmd(0x40);//--set start line address  Set Mapping RAM Display Start Line (0x00~0x3F)
  LCD_WrCmd(0x81);//--set contrast control register
  LCD_WrCmd(0xcf); // Set SEG Output Current Brightness
  LCD_WrCmd(0xa1);//--Set SEG/Column Mapping     0xa0左右反置 0xa1正常
  LCD_WrCmd(0xc8);//Set COM/Row Scan Direction   0xc0上下反置 0xc8正常
  LCD_WrCmd(0xa6);//--set normal display
  LCD_WrCmd(0xa8);//--set multiplex ratio(1 to 64)
  LCD_WrCmd(0x3f);//--1/64 duty
  LCD_WrCmd(0xd3);//-set display offset	Shift Mapping RAM Counter (0x00~0x3F)
  LCD_WrCmd(0x00);//-not offset
  LCD_WrCmd(0xd5);//--set display clock divide ratio/oscillator frequency
  LCD_WrCmd(0x80);//--set divide ratio, Set Clock as 100 Frames/Sec
  LCD_WrCmd(0xd9);//--set pre-charge period
  LCD_WrCmd(0xf1);//Set Pre-Charge as 15 Clocks & Discharge as 1 Clock
  LCD_WrCmd(0xda);//--set com pins hardware configuration
  LCD_WrCmd(0x12);
  LCD_WrCmd(0xdb);//--set vcomh
  LCD_WrCmd(0x40);//Set VCOM Deselect Level
  LCD_WrCmd(0x20);//-Set Page Addressing Mode (0x00/0x01/0x02)
  LCD_WrCmd(0x02);//
  LCD_WrCmd(0x8d);//--set Charge Pump enable/disable
  LCD_WrCmd(0x14);//--set(0x10) disable
  LCD_WrCmd(0xa4);// Disable Entire Display On (0xa4/0xa5)
  LCD_WrCmd(0xa6);// Disable Inverse Display On (0xa6/a7) 
  LCD_WrCmd(0xaf);//--turn on oled panel
  LCD_Fill(0x00);  //初始清屏
  LCD_Set_Pos(0,0);  
	
} 
//==============================================================
//函数名： void LCD_PutPixel(byte x,byte y)
//功能描述：绘制一个点（x,y）
//参数：真实坐标值(x,y),x的范围0～127，y的范围0～64
//返回：无
//==============================================================
void LCD_PutPixel(byte x,byte y)
{
	byte data1;  //data1当前点的数据 
	 
  LCD_Set_Pos(x,y); 
	data1 = 0x01<<(y%8); 	
	LCD_WrCmd(0xb0+(y>>3));
	LCD_WrCmd(((x&0xf0)>>4)|0x10);
	LCD_WrCmd((x&0x0f)|0x00);
	LCD_WrDat(data1); 	 	
}
//==============================================================
//函数名： void LCD_Rectangle(byte x1,byte y1,
//                   byte x2,byte y2,byte color,byte gif)
//功能描述：绘制一个实心矩形
//参数：左上角坐标（x1,y1）,右下角坐标（x2，y2）
//      其中x1、x2的范围0～127，y1，y2的范围0～63，即真实坐标值
//返回：无
//==============================================================
void LCD_Rectangle(byte x1,byte y1,byte x2,byte y2,byte gif)
{
	byte n; 
		
	LCD_Set_Pos(x1,y1>>3);
	for(n=x1;n<=x2;n++)
	{
		LCD_WrDat(0x01<<(y1%8)); 			
		if(gif == 1) 	LCD_DLY_ms(50);
	}  
	LCD_Set_Pos(x1,y2>>3);
  for(n=x1;n<=x2;n++)
	{
		LCD_WrDat(0x01<<(y2%8)); 			
		if(gif == 1) 	LCD_DLY_ms(5);
	}
	
}  
//==============================================================
//函数名：LCD_P6x8Str(byte x,byte y,byte *p)
//功能描述：写入一组标准ASCII字符串
//参数：显示的位置（x,y），y为页范围0～7，要显示的字符串
//返回：无
//==============================================================  
void LCD_P6x8Str(byte x,byte y,byte ch[])
{
  byte c=0,i=0,j=0;      
  while (ch[j]!='\0')
  {    
    c =ch[j]-32;
    if(x>126){x=0;y++;}
    LCD_Set_Pos(x,y);    
  	for(i=0;i<6;i++)     
  	  LCD_WrDat(F6x8[c][i]);  
  	x+=6;
  	j++;
  }
}



void LCD_P6x8Str_xiaoshudian(byte x,byte y,byte ch[])
{
  byte c=0,i=0,j=0;      
 // while (ch[j]!='\0')
  //{    
    c =ch[j]-32;
    if(x>126){x=0;y++;}
    LCD_Set_Pos(x,y);    
    //for(i=0;i<6;i++)     
      LCD_WrDat(F6x8[c][i]);  
    x+=6;
    j++;
 // }
}
//==============================================================
//函数名：LCD_P8x16Str(byte x,byte y,byte *p)
//功能描述：写入一组标准ASCII字符串
//参数：显示的位置（x,y），y为页范围0～7，要显示的字符串
//返回：无
//==============================================================  
void LCD_P8x16Str(byte x,byte y,byte ch[])
{
  byte c=0,i=0,j=0;
        
  while (ch[j]!='\0')
  {    
    c =ch[j]-32;
    if(x>120){x=0;y++;}
    LCD_Set_Pos(x,y);    
  	for(i=0;i<8;i++)     
  	  LCD_WrDat(F8X16[c*16+i]);
  	LCD_Set_Pos(x,y+1);    
  	for(i=0;i<8;i++)     
  	  LCD_WrDat(F8X16[c*16+i+8]);  
  	x+=8;
  	j++;
  }
}
//输出汉字字符串
void LCD_P16x16Str(byte x,byte y,byte ch[])
{
	byte wm=0,ii = 0;
	word adder=1; 
	
	while(ch[ii] != '\0')
	{
  	wm = 0;
  	adder = 1;
  	while(F16x16_Idx[wm] > 127)
  	{
  		if(F16x16_Idx[wm] == ch[ii])
  		{
  			if(F16x16_Idx[wm + 1] == ch[ii + 1])
  			{
  				adder = wm * 16;
  				break;
  			}
  		}
  		wm += 2;			
  	}
  	if(x>118){x=0;y++;}
  	LCD_Set_Pos(x , y); 
  	if(adder != 1)// 显示汉字					
  	{
  		LCD_Set_Pos(x , y);
  		for(wm = 0;wm < 16;wm++)               
  		{
  			LCD_WrDat(F16x16[adder]);	
  			adder += 1;
  		}      
  		LCD_Set_Pos(x,y + 1); 
  		for(wm = 0;wm < 16;wm++)          
  		{
  			LCD_WrDat(F16x16[adder]);
  			adder += 1;
  		}   		
  	}
  	else			  //显示空白字符			
  	{
  		ii += 1;
      LCD_Set_Pos(x,y);
  		for(wm = 0;wm < 16;wm++)
  		{
  				LCD_WrDat(0);
  		}
  		LCD_Set_Pos(x,y + 1);
  		for(wm = 0;wm < 16;wm++)
  		{   		
  				LCD_WrDat(0);	
  		}
  	}
  	x += 16;
  	ii += 2;
	}
}
//输出汉字和字符混合字符串
void LCD_Print(byte x, byte y, byte ch[])
{
	byte ch2[3];
	byte ii=0;        
	while(ch[ii] != '\0')
	{
		if(ch[ii] > 127)
		{
			ch2[0] = ch[ii];
	 		ch2[1] = ch[ii + 1];
			ch2[2] = '\0';			//汉字为两个字节
			LCD_P16x16Str(x , y, ch2);	//显示汉字
			x += 16;
			ii += 2;
		}
		else
		{
			ch2[0] = ch[ii];	
			ch2[1] = '\0';			//字母占一个字节
			LCD_P8x16Str(x , y , ch2);	//显示字母
			x += 8;
			ii+= 1;
		}
	}
} 


//==============================================================
//函数名：void LED_ShowInt(byte x,byte y,byte ch[])
//功能描述：显示一个int字符
//参数：显示的位置（x,y），y为页范围0～7，要显示的数字
//返回：无
//==============================================================  
void LCD_ShowInt(byte x,byte y,int num)
{
  byte tmpstr[6];
  byte flag_sta = 0;
  byte flag_nat = 0;
  int m = 0;
  unsigned int i = 10000,j = 0;
  if(num < 0) 
  {
      flag_nat = 1;
      num = num * -1;
  }
  
  for(m=0;m < 5;m++) 
  {
      j = num / i;
      if(j == 0 && flag_sta == 0) 
      {
         if(flag_nat == 1) 
         {
            tmpstr[m] = '-';
            if(m>0) tmpstr[m - 1] = ' ';
         } 
         else
            tmpstr[m] = ' ';
      } 
      else 
      {
         tmpstr[m] = j + '0';
         flag_sta = 1;
      }
      num = num % i;
      i = i / 10;
  }
  if(flag_sta == 0)
      tmpstr[4] = '0';
  tmpstr[5] = '\0';
  
  LCD_P6x8Str(x,y,tmpstr);
}

//==============================================================
//函数名： void Draw_BMP(byte x,byte y)
//功能描述：显示BMP图片128×64
//参数：起始点坐标(x,y),x的范围0～127，y为页的范围0～7
//返回：无
//==============================================================
void Draw_BMP(byte x0,byte y0,byte x1,byte y1,byte bmp[])
{ 	
  word ii=0;
  byte x,y;
  
  if(y1%8==0) y=y1/8;      
  else y=y1/8+1;
	for(y=y0;y<=y1;y++)
	{
		LCD_Set_Pos(x0,y);				
    for(x=x0;x<x1;x++)
	    {      
	    	LCD_WrDat(bmp[ii++]);	    	
	    }
	}
}
/***************************************************
** 函数名： void Draw_BUPTLogo(void)
** 功能描述：显示BUPT  loge
** 参数:
** 返回：无
***************************************************/
void Draw_BUPTLogo(byte xx,byte gif)
{ 	
  word ii=0;
  byte x = 0,y = 0;
         
  
	for(y=2;y<8;y++)
	{
          if(xx < Max_Column)
		LCD_Set_Pos(xx,y);	
          else
            LCD_Set_Pos(0,y);	
            for(x=0;x<72;x++)
	    {      
	    	LCD_WrDat(BUPT72x48[ii++]);
	    	if(gif == 1) 	LCD_DLY_ms(1);	    	
	    }
	}
}



/***************************************************
** 函数名： void LEDHead(void)
** 功能描述：画出标题
** 参数:
** 返回：无
***************************************************/
void LCDHead(void)
{ 	
  LCD_P6x8Str(20,0,"BUPT Smartcar");
}

byte MyCar128x64[]=
{
	0x00,0x00,0x00,0x00,0x00,0x00,0x00,0x00,
      0x00,0x00,0x00,0x00,0x00,0x00,0x00,0xF8,
      0xFE,0xFE,0x3E,0x78,0x70,0x70,0x78,0x3E,
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      0x00,0x00,0x00,0x00,0x00,0x00,0x00,0x00,
};
//MyCar
void Draw_MyCar(byte xx,byte gif)
{ 	
	word ii=0;
	byte x = 0,y = 0;
	
	for(y=0;y<8;y++)
	{
	  
		if(xx < Max_Column)
			LCD_Set_Pos(xx,y);	
		else
			LCD_Set_Pos(0,y);	
	  
		for(x=0;x<128;x++)
		{      
			LCD_WrDat(MyCar128x64[ii++]);
			if(gif == 1) 	
			  	LCD_DLY_us(500);	    	
		}
	}
}